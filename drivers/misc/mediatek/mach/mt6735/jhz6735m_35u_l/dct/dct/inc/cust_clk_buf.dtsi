/*
 * Generated by MTK SP Drv_CodeGen Version 03.13.6  for MT6735M. Copyright MediaTek Inc. (C) 2013.
 * Thu Feb 25 12:41:37 2016
 * Do Not Modify the File.
 */

&rf_clock_buffer_ctrl {
	compatible = "mediatek, rf_clock_buffer";
	buffer1 = <1>;
	buffer2 = <2>;
	buffer3 = <2>;
	buffer4 = <2>;
};
