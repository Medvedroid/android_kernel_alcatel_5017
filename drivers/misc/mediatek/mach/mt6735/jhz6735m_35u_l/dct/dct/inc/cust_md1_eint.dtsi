/*
 * Generated by MTK SP Drv_CodeGen Version 03.13.6  for MT6735M. Copyright MediaTek Inc. (C) 2013.
 * Thu Feb 25 12:41:36 2016
 * Do Not Modify the File.
 */

/*********************************************
 *MD EINT DTSI File
*********************************************/

MD1_SIM1_HOT_PLUG_EINT@0 {
	compatible = "mediatek, MD1_SIM1_HOT_PLUG_EINT-eint";
	interrupts = <0 4>;
	debounce = <0 100000>;
	dedicated = <0 0>;
	src_pin = <0 162635632>;
	sockettype=<0 1>;
};

MD1_SIM2_HOT_PLUG_EINT@1 {
	compatible = "mediatek, MD1_SIM2_HOT_PLUG_EINT-eint";
	interrupts = <1 4>;
	debounce = <1 100000>;
	dedicated = <1 0>;
	src_pin = <1 162635632>;
	sockettype=<1 1>;
};

